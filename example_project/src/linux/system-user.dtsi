/include/ "system-conf.dtsi"
/ {
	usb_phy0: usb_phy@0 {
		compatible = "ulpi-phy";
		#phy-cells = <0>;
		reg = <0xe0002000 0x1000>;
		view-port = <0x0170>;
		drv-vbus;
	};
};

&usb0 {	
	usb-phy = <&usb_phy0>;
	dr_mode = "host";
	/delete-property/ usb-reset;
};